## doc/fm2kconfig/Kconfig.alt
```kconfig
config CONFIG_A
	bool "Feature A"

choice
	bool "Alternative group of feature A"
	depends on CONFIG_A

	config CONFIG_B
		bool "Feature B"

	config CONFIG_C
		bool "Feature C"

	config CONFIG_D
		bool "Feature D"

endchoice
```

## doc/fm2kconfig/Kconfig.mandatory
```kconfig
config CONFIG_A
	bool "Feature A"
	select CONFIG_B

config CONFIG_B
	bool
	depends on CONFIG_A

config CONFIG_C
	bool "Feature C"
	depends on CONFIG_B
```

## doc/fm2kconfig/Kconfig.or
```kconfig
config FEATURE_Z
  bool "Feature Z"

config FEATURE_B
  bool "Feature B"
  depends on FEATURE_Z

config FEATURE_A
	bool "Or group of A"
	depends on CHILD_B || CHILD_C || CHILD_D
        select FEATURE_Z
        imply FEATURE_Z

config CHILD_B
	bool "Feature B in or group of A"
	select FEATURE_A
        depends on FEATURE_Z

config CHILD_C
	bool "Feature C in or group of A"
	select FEATURE_A
        depends on FEATURE_Z

config CHILD_D
	bool "Feature D in or group of A"
	select FEATURE_A
        depends on FEATURE_Z
```

## doc/fm2kconfig/Kconfig.or_new
```kconfig
config F1
  bool "Feature 1"

choice CH_F1
  bool "Or group of Feature 1 (first selection)"
  depends on F1

  config F2
    bool "Feature 2"
    select OPTIONS

  config F3
    bool "Feature 3"
    select OPTIONS

  config F4
    bool "Feature 4"
    select OPTIONS

endchoice

menuconfig OPTIONS
  bool "Additional selections for or group of Feature 1"
  depends on false

config OPT_F2
  bool "Additional selection F2"
  depends on !F2
  depends on OPTIONS

config OPT_F3
  bool "Additional selection F3"
  depends on !F3
  depends on OPTIONS

config OPT_F4
  bool "Additional selection F4"
  depends on !F4
  depends on OPTIONS

choice CH_F4
  bool "Or group of Feature 4 (first selection)"
  depends on F4 || OPT_F4

  config F7
    bool "Feature 7"
    select OPTIONS_F4

  config F8
    bool "Feature 8"
    select OPTIONS_F4

endchoice

menuconfig OPTIONS_F4
  bool "Additional selections for or group of Feature 4"
  depends on false

config OPT_F7
  bool "Additional selection F7"
  depends on !F7
  depends on OPTIONS_F4

config OPT_F8
  bool "Additional selection F8"
  depends on !F8
  depends on OPTIONS_F4
```
